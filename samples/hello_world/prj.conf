## prj.conf
```kconfig
CONFIG_STDOUT_CONSOLE=y
CONFIG_NET_CONFIG_SETTINGS=y
CONFIG_NETWORKING=y
CONFIG_NET_IPV6=n
CONFIG_NET_IPV4=y
CONFIG_NET_ARP=y
CONFIG_NET_UDP=y
CONFIG_NET_DHCPV4=y
CONFIG_NET_DHCPV4_OPTION_CALLBACKS=y
CONFIG_ETH_DRIVER=y
CONFIG_ETH_ADIN2111=y
CONFIG_MDIO=y
CONFIG_SPI=y
CONFIG_GPIO=y
CONFIG_INIT_STACKS=y
CONFIG_NET_CONFIG_AUTO_INIT=y
CONFIG_TEST_RANDOM_GENERATOR=y

CONFIG_NET_CONFIG_INIT_TIMEOUT=10000

CONFIG_NET_ZPERF=y
CONFIG_NET_SOCKETS=y

CONFIG_INIT_STACKS=y

CONFIG_NET_MGMT=y
CONFIG_NET_MGMT_EVENT=y

CONFIG_NET_LOG=y
CONFIG_LOG=y
CONFIG_NET_SHELL=y

CONFIG_NET_L2_ETHERNET=y
CONFIG_NET_CONFIG_NEED_IPV4=y
CONFIG_NET_STATISTICS=y
CONFIG_MDIO_SHELL=n
CONFIG_NET_L2_ETHERNET=y

CONFIG_NET_IF_MAX_IPV4_COUNT=3
CONFIG_ETHERNET_LOG_LEVEL_DBG=y
CONFIG_MDIO_INIT_PRIORITY=81
CONFIG_PHY_INIT_PRIORITY=82
```

## src/main.c
```c
/* Networking DHCPv4 client */

/*
 * Copyright (c) 2017 ARM Ltd.
 * Copyright (c) 2016 Intel Corporation.
 *
 * SPDX-License-Identifier: Apache-2.0
 */

#include <zephyr/kernel.h>
#include <zephyr/device.h>
#include <zephyr/linker/sections.h>
#include <errno.h>
#include <stdio.h>

#include <zephyr/net/net_if.h>
#include <zephyr/net/net_core.h>
#include <zephyr/net/net_context.h>
#include <zephyr/net/net_mgmt.h>
#include <zephyr/sys/__assert.h>

int main(void)
{
	const struct device *const dev = DEVICE_DT_GET_ONE(adi_adin2111);

	return 0;
}
```
