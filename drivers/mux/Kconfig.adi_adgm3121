## drivers/mux/Kconfig.adi_adgm3121
```kconfig
# SPDX-FileCopyrightText: 2026 NXP
# SPDX-FileCopyrightText: 2026 Analog Devices Inc.
# SPDX-License-Identifier: Apache-2.0

config MUX_ADI_ADGM3121
	bool "ADI ADGM3121/ADGM3053 MEMS switch MUX driver"
	default y
	depends on DT_HAS_ADI_ADGM3121_ENABLED || DT_HAS_ADI_ADGM3121_GPIO_ENABLED || \
		DT_HAS_ADI_ADGM3053_ENABLED || DT_HAS_ADI_ADGM3053_GPIO_ENABLED
	select SPI if DT_HAS_ADI_ADGM3121_ENABLED || DT_HAS_ADI_ADGM3053_ENABLED
	select GPIO if DT_HAS_ADI_ADGM3121_GPIO_ENABLED || DT_HAS_ADI_ADGM3053_GPIO_ENABLED
	help
	  Enable the ADI ADGM3121 DPDT MEMS switch and the ADGM3053 4-channel
	  MEMS crossover switch as a MUX controller. The four switches are
	  exposed as a single control line whose state is a 4-bit switch bitmask
	  (bit i = SW(i+1)). Both SPI (adi,adgm3121, adi,adgm3053) and parallel
	  GPIO (adi,adgm3121-gpio, adi,adgm3053-gpio) control modes are
	  supported.

if MUX_ADI_ADGM3121

config MUX_ADI_ADGM3121_INIT_PRIORITY
	int "ADGM3121 init priority"
	default 60
	help
	  Device initialization priority. Unlike on-chip MUX backends, the
	  ADGM3121 sits on a bus, so it must initialize later than its SPI or
	  GPIO controller (SPI_INIT_PRIORITY defaults to
	  KERNEL_INIT_PRIORITY_DEVICE) while still being earlier than any MUX
	  consumer that references it.

endif # MUX_ADI_ADGM3121
```

## dts/bindings/mux/adi,adgm3053-gpio.yaml
```yaml
# SPDX-FileCopyrightText: 2026 Analog Devices Inc.
# SPDX-License-Identifier: Apache-2.0

description: |
  Analog Devices ADGM3053 4-channel MEMS crossover switch (DC-14GHz), parallel
  GPIO control mode, exposed as a MUX controller.

  Each source Sx (S1..S4) is routed either to its drain Dx through its port
  switch (SW1..SW4) or to the internal crossover path shared by all sources.
  Each port switch is controlled by a dedicated GPIO pin (IN1..IN4). The four
  switches are modeled as a single control line whose state is a 4-bit switch
  bitmask: bit i set routes S(i+1) to D(i+1), bit i clear routes S(i+1) to the
  crossover path. All sources with a clear bit are connected together, for
  example 0xc routes S3 to D3 and S4 to D4 and connects S1 to S2.

  No state leaves every source unrouted, so mux_control_disconnect() returns
  -ENOSYS.

compatible: "adi,adgm3053-gpio"

include: [base.yaml, mux-controller.yaml]

properties:
  in1-gpios:
    type: phandle-array
    required: true
    description: GPIO controlling switch SW1 (S1-D1).

  in2-gpios:
    type: phandle-array
    required: true
    description: GPIO controlling switch SW2 (S2-D2).

  in3-gpios:
    type: phandle-array
    required: true
    description: GPIO controlling switch SW3 (S3-D3).

  in4-gpios:
    type: phandle-array
    required: true
    description: GPIO controlling switch SW4 (S4-D4).

  "#mux-control-cells":
    const: 0

  "#mux-state-cells":
    const: 1

mux-state-cells:
  - switches

examples:
  - |
    #include <zephyr/dt-bindings/gpio/gpio.h>

    adgm3053 {
            compatible = "adi,adgm3053-gpio";
            in1-gpios = <&gpio0 0 GPIO_ACTIVE_HIGH>;
            in2-gpios = <&gpio0 1 GPIO_ACTIVE_HIGH>;
            in3-gpios = <&gpio0 2 GPIO_ACTIVE_HIGH>;
            in4-gpios = <&gpio0 3 GPIO_ACTIVE_HIGH>;
            #mux-control-cells = <0>;
            #mux-state-cells = <1>;
    };
```

## dts/bindings/mux/adi,adgm3053.yaml
```yaml
# SPDX-FileCopyrightText: 2026 Analog Devices Inc.
# SPDX-License-Identifier: Apache-2.0

description: |
  Analog Devices ADGM3053 4-channel MEMS crossover switch (DC-14GHz), SPI
  control mode, exposed as a MUX controller.

  Each source Sx (S1..S4) is routed either to its drain Dx through its port
  switch (SW1..SW4) or to the internal crossover path shared by all sources.
  The four switches are modeled as a single control line whose state is a
  4-bit switch bitmask: bit i set routes S(i+1) to D(i+1), bit i clear routes
  S(i+1) to the crossover path. All sources with a clear bit are connected
  together, for example 0xc routes S3 to D3 and S4 to D4 and connects S1 to
  S2.

  No state leaves every source unrouted, so mux_control_disconnect() returns
  -ENOSYS.

compatible: "adi,adgm3053"

include: [spi-device.yaml, mux-controller.yaml]

properties:
  "#mux-control-cells":
    const: 0

  "#mux-state-cells":
    const: 1

mux-state-cells:
  - switches

examples:
  - |
    &spi1 {
            adgm3053: adgm3053@0 {
                    compatible = "adi,adgm3053";
                    reg = <0>;
                    spi-max-frequency = <10000000>;
                    #mux-control-cells = <0>;
                    #mux-state-cells = <1>;
            };
    };

    consumer {
            mux-controls = <&adgm3053>;        /* runtime switch mask */
            mux-states   = <&adgm3053 0xc>;    /* static: S3-D3, S4-D4, S1-S2 */
    };
```
