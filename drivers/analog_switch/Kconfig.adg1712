## drivers/analog_switch/Kconfig.adg1712
```kconfig
# Copyright (c) 2026 Analog Devices Inc.
# SPDX-License-Identifier: Apache-2.0

config ANALOG_SWITCH_ADG1712
	bool "Analog Devices ADG1712/ADG2712 quad SPST analog switch driver"
	default y
	depends on DT_HAS_ADI_ADG1712_ENABLED || \
		   DT_HAS_ADI_ADG2712_ENABLED
	depends on GPIO
	help
	  Enable driver for Analog Devices ADG1712/ADG2712 quad SPST
	  analog switch. Each of the 4 switches is driven by a dedicated
	  GPIO.
```

## drivers/analog_switch/Kconfig.adg1736
```kconfig
# Copyright (c) 2026 Analog Devices Inc.
# SPDX-License-Identifier: Apache-2.0

config ANALOG_SWITCH_ADG1736
	bool "Analog Devices ADG736/ADG1736 dual SPDT analog switch driver"
	default y
	depends on DT_HAS_ADI_ADG736_ENABLED || \
		   DT_HAS_ADI_ADG1736_ENABLED
	depends on GPIO
	help
	  Enable driver for Analog Devices ADG736/ADG1736 dual SPDT analog
	  switch. Each of the 2 switches is driven by a dedicated GPIO and
	  the ADG1736 variant supports an optional enable pin.
```

## dts/bindings/analog-switch/adi,adg1736-common.yaml
```yaml
# Copyright (c) 2026 Analog Devices Inc.
# SPDX-License-Identifier: Apache-2.0

description: |
  Common properties for Analog Devices dual SPDT analog switches in the
  ADG[1]736 family driven by 2 dedicated GPIO control pins.

properties:
  in1-gpios:
    type: phandle-array
    required: true
    description: GPIO controlling switch SW1 path (0 = B, 1 = A).

  in2-gpios:
    type: phandle-array
    required: true
    description: GPIO controlling switch SW2 path (0 = B, 1 = A).
```

## dts/bindings/analog-switch/adi,adg17xx-common.yaml
```yaml
# Copyright (c) 2026 Analog Devices Inc.
# SPDX-License-Identifier: Apache-2.0

description: |
  Common properties for Analog Devices quad SPST analog switches in the
  ADG17xx family driven by 4 dedicated GPIO control pins.

properties:
  in1-gpios:
    type: phandle-array
    required: true
    description: GPIO controlling switch SW1.

  in2-gpios:
    type: phandle-array
    required: true
    description: GPIO controlling switch SW2.

  in3-gpios:
    type: phandle-array
    required: true
    description: GPIO controlling switch SW3.

  in4-gpios:
    type: phandle-array
    required: true
    description: GPIO controlling switch SW4.
```
