## boards/arm/adin6310-ethernet-switch/Kconfig.board
```kconfig
# MAX32690 board configuration

# Copyright (c) 2023 Analog Devices, Inc.
# SPDX-License-Identifier: Apache-2.0

config BOARD_ADIN6310_ETHERNET_SWITCH
	bool "ADIN6310_ETHERNET_SWITCH"
	depends on SOC_MAX32690
```

## drivers/misc/adgm3121/Kconfig
```kconfig
# Copyright (c) 2025 Analog Devices Inc.
# SPDX-License-Identifier: Apache-2.0

config ADGM3121
	bool "Analog Devices ADGM3121/ADGM3053 MEMS switch driver"
	default y
	depends on DT_HAS_ADI_ADGM3121_ENABLED || \
		   DT_HAS_ADI_ADGM3053_ENABLED || \
		   DT_HAS_ADI_ADGM3121_GPIO_ENABLED || \
		   DT_HAS_ADI_ADGM3053_GPIO_ENABLED
	depends on SPI || GPIO
	help
	  Enable driver for Analog Devices ADGM3121 (DPDT MEMS switch,
	  DC-24GHz) and ADGM3053 (4-channel crossover MEMS switch,
	  DC-14GHz). Supports both SPI and parallel GPIO control modes.

if ADGM3121

config ADGM3121_INIT_PRIORITY
	int "Init priority"
	default 90
	help
	  Analog Devices ADGM3121/ADGM3053 MEMS switch driver
	  initialization priority.

module = ADGM3121
module-str = adgm3121
source "subsys/logging/Kconfig.template.log_config"

endif # ADGM3121
```

## drivers/rtc/Kconfig.max32
```kconfig
# Copyright (c) 2023 Analog Devices, Inc.
# SPDX-License-Identifier: Apache-2.0

config RTC_MAX32
	bool "RTC driver for MAX32 MCU family"
	default y
```

## dts/bindings/adc/adi,max32-adc.yaml
```yaml
# Copyright (c) 2023 Analog Devices, Inc.
# SPDX-License-Identifier: Apache-2.0

description: ADI MAX32 I2C

compatible: "adi,max32-adc"

include: [adc-controller.yaml, pinctrl-device.yaml]

properties:
  reg:
    required: true

  interrupts:
    required: true

  clocks:
    required: true

  pinctrl-0:
    required: true

  pinctrl-names:
    required: true

  channel-count:
    type: int
    required: true
    description: The maximum channels supported on each unit.

  vref-mv:
    type: int
    required: true
    description: Indicates the reference voltage of the ADC in mV (on the target board).

  resolution:
    type: int
    required: true
    description: Indicates the resolution supported by the ADC instance.

  "#io-channel-cells":
    const: 1

io-channel-cells:
  - input
```

## dts/bindings/misc/adi,adgm3053-gpio.yaml
```yaml
# Copyright (c) 2025 Analog Devices Inc.
# SPDX-License-Identifier: Apache-2.0

description: |
  Analog Devices ADGM3053 4-channel crossover MEMS switch (DC-14GHz),
  parallel GPIO control mode.

  Each of the 4 MEMS switches is controlled by a dedicated GPIO pin
  (IN1 through IN4).

  Example:

    adgm3053 {
      compatible = "adi,adgm3053-gpio";
      in1-gpios = <&gpio0 0 GPIO_ACTIVE_HIGH>;
      in2-gpios = <&gpio0 1 GPIO_ACTIVE_HIGH>;
      in3-gpios = <&gpio0 2 GPIO_ACTIVE_HIGH>;
      in4-gpios = <&gpio0 3 GPIO_ACTIVE_HIGH>;
    };

compatible: "adi,adgm3053-gpio"

properties:
  in1-gpios:
    type: phandle-array
    required: true
    description: GPIO controlling switch SW1 (S1-D1)

  in2-gpios:
    type: phandle-array
    required: true
    description: GPIO controlling switch SW2 (S2-D2)

  in3-gpios:
    type: phandle-array
    required: true
    description: GPIO controlling switch SW3 (S3-D3)

  in4-gpios:
    type: phandle-array
    required: true
    description: GPIO controlling switch SW4 (S4-D4)
```

## dts/bindings/misc/adi,adgm3053.yaml
```yaml
# Copyright (c) 2025 Analog Devices Inc.
# SPDX-License-Identifier: Apache-2.0

description: |
  Analog Devices ADGM3053 4-channel crossover MEMS switch (DC-14GHz),
  SPI control mode.

  The ADGM3053 contains 4 MEMS switches controlled via a single SPI register
  at address 0x20 using 16-bit SPI frames (Mode 0, MSB-first, max 10MHz).

  Example:

    &spi1 {
      adgm3053: adgm3053@0 {
        compatible = "adi,adgm3053";
        reg = <0>;
        spi-max-frequency = <10000000>;
      };
    };

compatible: "adi,adgm3053"

include: spi-device.yaml
```

## dts/bindings/sensor/adi,adxl367-spi.yaml
```yaml
# Copyright (c) 2023 Analog Devices Inc.
# SPDX-License-Identifier: Apache-2.0

description: ADXL367 3-axis nanopower accelerometer, accessed through SPI bus

compatible: "adi,adxl367"

include: ["spi-device.yaml", "adi,adxl367-common.yaml"]

properties:
  int1-gpios:
    type: phandle-array
    description: |
      The INT1 signal defaults to active high as produced by the
      sensor.  The property value should ensure the flags properly
      describe the signal that is presented to the driver.
```

## soc/arm/adi_max/max32/Kconfig.defconfig.max32666
```kconfig
# Analog Devices MAX32665 MCU

# Copyright (c) 2023 Analog Devices, Inc.
# SPDX-License-Identifier: Apache-2.0

if SOC_MAX32666 || SOC_MAX32665

config SOC
	default "max32666"

config NUM_IRQS
	default 110

config SERIAL_SUPPORT_PARITY_MARK
	bool
	default y

config SERIAL_SUPPORT_PARITY_SPACE
	bool
	default y

endif # SOC_MAX32666 || SOC_MAX32665
```

## tests/drivers/adc/adc_dma/boards/max32666fthr.conf
```kconfig
#
# Copyright (c) 2020, ADI
#
# SPDX-License-Identifier: Apache-2.0
#

CONFIG_ADC_MAX32_DMA=y
CONFIG_ADC_ASYNC=y
```

## tests/drivers/misc/adgm3121/gpio/testcase.yaml
```yaml
# Copyright (c) 2026 Analog Devices Inc.
# SPDX-License-Identifier: Apache-2.0

tests:
  drivers.misc.adgm3121.gpio:
    tags:
      - drivers
      - misc
    harness: ztest
    platform_allow:
      - native_sim
    integration_platforms:
      - native_sim
```

## tests/drivers/spi/spi_loopback/Kconfig
```kconfig
# SPDX-License-Identifier: Apache-2.0

mainmenu "SPI Loopback Test"

source "Kconfig.zephyr"

config SPI_LOOPBACK_MODE_LOOP
	bool "Configure the SPI in LOOP mode, so that no extra wiring is needed"

if SOC_SERIES_STM32H7X || SOC_SERIES_MAX32

config SPI_LOOPBACK_16BITS_FRAMES
	bool "Use 16 bits frames for tests"

endif # SOC_SERIES_STM32H7 || SOC_SERIES_MAX32

if SOC_SERIES_STM32H7X

config DT_DEFINED_NOCACHE
	bool "Enable this if nocache regions are defined in devicetree"

if DT_DEFINED_NOCACHE

config DT_DEFINED_NOCACHE_NAME
	string "Name of the nocache region defined in devicetree (capitals)"

endif # DT_DEFINED_NOCACHE

endif # SOC_SERIES_STM32H7X
```

## tests/drivers/spi/spi_loopback/boards/max32666fthr2.conf
```kconfig
#
# Copyright (c) 2023 Analog Devices, Inc.
#
# SPDX-License-Identifier: Apache-2.0
#
CONFIG_SPI_ASYNC=y
CONFIG_SPI_MAX32_INTERRUPT=y
CONFIG_SPI_MAX32_DMA=y
```
